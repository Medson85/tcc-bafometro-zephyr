## CMakeLists.txt
```
cmake_minimum_required(VERSION 3.20.0)

find_package(Zephyr REQUIRED HINTS $ENV{ZEPHYR_BASE})
project(teste_falhas)

include(${CMAKE_CURRENT_SOURCE_DIR}/../../app/fontes.cmake)

# Máquina e domínio reais; dispositivos substituídos por dublês que injetam falhas.
target_include_directories(app PRIVATE ${BAFOMETRO_INCLUDES} src)
target_sources(app PRIVATE
  src/teste_falhas.c
  src/dispositivos_falsos.c
  ${BAFOMETRO_FONTES_DOMINIO}
  ${BAFOMETRO_FONTES_APLICACAO}
)
```

## prj.conf
```kconfig
CONFIG_ZTEST=y
CONFIG_SMF=y

CONFIG_LOG=y
CONFIG_LOG_DEFAULT_LEVEL=2

# Tempo simulado o mais rápido possível (os testes rodam só no native_sim)
CONFIG_NATIVE_SIM_SLOWDOWN_TO_REAL_TIME=n
```

## src/dispositivos_falsos.c
```c
#include <errno.h>

#include <zephyr/sys/util.h>

#include "config_produto.h"
#include "dispositivos/ble.h"
#include "dispositivos/detector_sopro.h"
#include "dispositivos/inibidor.h"
#include "dispositivos/sensor_alcool.h"
#include "dispositivos/tela.h"
#include "dispositivos_falsos.h"

struct DispositivosFalsos falsos;

/* Ar limpo com o R0 padrão: VRL = VCC * RL / (RL + R0). */
#define TENSAO_AR_LIMPO_MV                                                                         \
	((int32_t)(TENSAO_ALIMENTACAO_MV * RESISTENCIA_CARGA_OHMS /                                \
			   (RESISTENCIA_CARGA_OHMS + (float)R0_PADRAO_OHMS) +                      \
		   0.5f))

void falsos_reiniciar(void)
{
	falsos = (struct DispositivosFalsos){
		.tensaoMv = TENSAO_AR_LIMPO_MV,
		.inibidorAtivo = true,
		.fase = FASE_REPOUSO,
	};
}

void falsos_iniciarSopro(void)
{
	falsos.soproPresente = true;
	if (falsos.detectorArmado && (falsos.aoDetectar != NULL)) {
		falsos.aoDetectar();
	}
}

void falsos_encerrarSopro(void)
{
	falsos.soproPresente = false;
}

/* Inibidor: mesmo contrato do módulo real; em erro, o estado lógico fica ativo. */
static int comandarInibidor(bool ativo)
{
	if (falsos.erroInibidorComando != 0) {
		falsos.inibidorAtivo = true;
		return falsos.erroInibidorComando;
	}

	falsos.inibidorAtivo = ativo;
	return 0;
}

int inibidor_iniciar(void)
{
	falsos.inibidorAtivo = true;
	return falsos.erroInibidorIniciar;
}

int inibidor_ativar(void)
{
	return comandarInibidor(true);
}

int inibidor_liberar(void)
{
	return comandarInibidor(false);
}

bool inibidor_estaAtivo(void)
{
	return falsos.inibidorAtivo;
}

/* Sensor: a fase só muda quando a troca não falha. */
int sensor_alcool_iniciar(void)
{
	return falsos.erroSensorIniciar;
}

int sensor_alcool_definirFase(enum FaseAquecedor fase)
{
	if (falsos.erroFase[fase] != 0) {
		falsos.fase = FASE_REPOUSO;
		return falsos.erroFase[fase];
	}

	falsos.fase = fase;
	return 0;
}

int sensor_alcool_lerTensaoMv(int32_t *tensaoMv)
{
	if (falsos.erroLeitura != 0) {
		return falsos.erroLeitura;
	}

	*tensaoMv = falsos.tensaoMv;
	return 0;
}

int sensor_alcool_carregarR0(uint32_t *r0Ohms)
{
	ARG_UNUSED(r0Ohms);
	return -ENOENT;
}

/* Detector */
int detector_sopro_iniciar(AoDetectarSopro aoDetectar)
{
	falsos.aoDetectar = aoDetectar;
	return falsos.erroDetectorIniciar;
}

int detector_sopro_armar(void)
{
	if (falsos.erroDetectorArmar != 0) {
		return falsos.erroDetectorArmar;
	}

	falsos.detectorArmado = true;
	return 0;
}

int detector_sopro_desarmar(void)
{
	falsos.detectorArmado = false;
	return 0;
}

bool detector_sopro_presente(void)
{
	return falsos.soproPresente;
}

/* Tela e BLE: sem efeito nos testes de falhas. */
void tela_mostrarMensagem(const char *texto)
{
	ARG_UNUSED(texto);
}

void tela_mostrarContagem(const char *texto, uint32_t segundos)
{
	ARG_UNUSED(texto);
	ARG_UNUSED(segundos);
}

void tela_mostrarResultado(const struct ResultadoMedicao *resultado)
{
	ARG_UNUSED(resultado);
}

void tela_apagar(void)
{
}

void ble_notificarEstado(uint8_t estado)
{
	ARG_UNUSED(estado);
}

void ble_notificarResultado(const struct ResultadoMedicao *resultado)
{
	ARG_UNUSED(resultado);
}

void ble_definirAnuncioLento(bool lento)
{
	ARG_UNUSED(lento);
}
```

## src/dispositivos_falsos.h
```c
/*
 * Dublês dos módulos de dispositivo para os testes de falhas: mesmas assinaturas
 * de app/src/dispositivos, com retornos controlados pelo teste e estado observável.
 */

#ifndef BAFOMETRO_DISPOSITIVOS_FALSOS_H
#define BAFOMETRO_DISPOSITIVOS_FALSOS_H

#include <stdbool.h>
#include <stdint.h>

#include "dispositivos/detector_sopro.h"
#include "dispositivos/sensor_alcool.h"

#define QTD_FASES_AQUECEDOR 3

struct DispositivosFalsos {
	/* Erros devolvidos às chamadas (0 = sucesso). */
	int erroInibidorIniciar;
	int erroInibidorComando; /* inibidor_ativar e inibidor_liberar */
	int erroDetectorIniciar;
	int erroDetectorArmar;
	int erroSensorIniciar;
	int erroFase[QTD_FASES_AQUECEDOR];
	int erroLeitura;

	/* Entradas simuladas. */
	int32_t tensaoMv;
	bool soproPresente;

	/* Estado observado. */
	bool inibidorAtivo;
	enum FaseAquecedor fase;
	bool detectorArmado;
	AoDetectarSopro aoDetectar;
};

extern struct DispositivosFalsos falsos;

/* Sem erros, ar limpo com o R0 padrão, inibidor ativo e aquecedor em repouso. */
void falsos_reiniciar(void);

/* Início de um sopro: marca a presença e, se o detector estiver armado, avisa a máquina. */
void falsos_iniciarSopro(void);
void falsos_encerrarSopro(void);

#endif /* BAFOMETRO_DISPOSITIVOS_FALSOS_H */
```

## src/teste_falhas.c
```c
/*
 * Testes de falhas (RF10, ADR 0002): a máquina de estados real, ligada a dublês dos
 * dispositivos, recebe falhas injetadas que o GPIO e o ADC emulados não produzem.
 * Toda falha deve levar ao ERRO com o inibidor ativo e o aquecedor em repouso.
 */

#include <errno.h>

#include <zephyr/kernel.h>
#include <zephyr/ztest.h>

#include "aplicacao/bafometro.h"
#include "config_produto.h"
#include "dispositivos_falsos.h"

#define FALHA_DE_ESCRITA (-EIO)

/* 200 ppm com o R0 padrão (Rs/R0 = 0,047): VRL = VCC * RL / (RL + Rs). */
#define TENSAO_ALCOOL_MV                                                                           \
	((int32_t)(TENSAO_ALIMENTACAO_MV * RESISTENCIA_CARGA_OHMS /                                \
			   (RESISTENCIA_CARGA_OHMS + (float)R0_PADRAO_OHMS * 0.047f) +             \
		   0.5f))

static bool processarAte(enum EstadoBafometro alvo, uint32_t limiteMs)
{
	int64_t inicio = k_uptime_get();

	while (bafometro_estadoAtual() != alvo) {
		if ((k_uptime_get() - inicio) > limiteMs) {
			return false;
		}
		(void)bafometro_processarProximoEvento(K_MSEC(10));
	}

	return true;
}

static void processarPor(uint32_t duracaoMs)
{
	int64_t fim = k_uptime_get() + duracaoMs;

	while (k_uptime_get() < fim) {
		(void)bafometro_processarProximoEvento(K_MSEC(5));
	}
}

static void chegarEmAguardandoSopro(void)
{
	zassert_true(processarAte(ESTADO_AGUARDANDO_SOPRO,
				  TEMPO_PRE_AQUECIMENTO_MS + TEMPO_ACOMODACAO_FASE_MS + 100U));
}

static void chegarEmColetando(void)
{
	chegarEmAguardandoSopro();
	falsos_iniciarSopro();
	zassert_true(processarAte(ESTADO_COLETANDO, 10U));
}

/* Estado seguro exigido em qualquer falha. */
static void conferirErro(enum CodigoFalha codigo)
{
	zassert_equal(bafometro_estadoAtual(), ESTADO_ERRO);
	zassert_equal(bafometro_codigoErro(), codigo);
	zassert_true(falsos.inibidorAtivo);
	zassert_equal(falsos.fase, FASE_REPOUSO);
}

static void antesDeCadaTeste(void *fixture)
{
	ARG_UNUSED(fixture);

	/* Cada teste configura as falhas e só então inicia a máquina. */
	falsos_reiniciar();
}

ZTEST_SUITE(falhas, NULL, NULL, antesDeCadaTeste, NULL, NULL);

ZTEST(falhas, test_falha_ao_iniciar_o_inibidor_leva_ao_erro)
{
	falsos.erroInibidorIniciar = -ENODEV;
	zassert_ok(bafometro_iniciar());
	conferirErro(FALHA_INIBIDOR);
}

ZTEST(falhas, test_falha_ao_iniciar_o_detector_leva_ao_erro)
{
	falsos.erroDetectorIniciar = -ENODEV;
	zassert_ok(bafometro_iniciar());
	conferirErro(FALHA_DETECTOR_SOPRO);
}

ZTEST(falhas, test_falha_ao_iniciar_o_sensor_leva_ao_erro)
{
	falsos.erroSensorIniciar = -ENODEV;
	zassert_ok(bafometro_iniciar());
	conferirErro(FALHA_SENSOR_ALCOOL);
}

ZTEST(falhas, test_falha_na_fase_de_aquecimento_leva_ao_erro)
{
	falsos.erroFase[FASE_AQUECIMENTO] = FALHA_DE_ESCRITA;
	zassert_ok(bafometro_iniciar());
	conferirErro(FALHA_AQUECEDOR);
}

ZTEST(falhas, test_falha_na_fase_de_operacao_leva_ao_erro)
{
	falsos.erroFase[FASE_OPERACAO] = FALHA_DE_ESCRITA;
	zassert_ok(bafometro_iniciar());
	zassert_true(processarAte(ESTADO_ERRO, TEMPO_PRE_AQUECIMENTO_MS + 100U));
	conferirErro(FALHA_AQUECEDOR);
}

ZTEST(falhas, test_falha_no_repouso_da_economia_leva_ao_erro)
{
	falsos.erroFase[FASE_REPOUSO] = FALHA_DE_ESCRITA;
	zassert_ok(bafometro_iniciar());
	chegarEmAguardandoSopro();
	zassert_true(processarAte(ESTADO_ERRO, TEMPO_ESPERA_SOPRO_MS + 100U));

	/* O repouso também falha dentro do ERRO; o dublê registra o aquecedor sem energia. */
	conferirErro(FALHA_AQUECEDOR);
}

ZTEST(falhas, test_falha_ao_armar_o_detector_leva_ao_erro)
{
	falsos.erroDetectorArmar = FALHA_DE_ESCRITA;
	zassert_ok(bafometro_iniciar());
	zassert_true(processarAte(ESTADO_ERRO,
				  TEMPO_PRE_AQUECIMENTO_MS + TEMPO_ACOMODACAO_FASE_MS + 100U));
	conferirErro(FALHA_DETECTOR_SOPRO);
}

/* Ar limpo levaria à liberação; o comando falha e o resultado não é apresentado. */
ZTEST(falhas, test_falha_ao_liberar_o_inibidor_leva_ao_erro)
{
	zassert_ok(bafometro_iniciar());
	chegarEmColetando();
	falsos.erroInibidorComando = FALHA_DE_ESCRITA;
	zassert_true(processarAte(ESTADO_ERRO, TEMPO_SOPRO_MINIMO_MS + 100U));
	falsos_encerrarSopro();
	conferirErro(FALHA_INIBIDOR);
}

ZTEST(falhas, test_falha_ao_ativar_o_inibidor_leva_ao_erro)
{
	falsos.tensaoMv = TENSAO_ALCOOL_MV;
	zassert_ok(bafometro_iniciar());
	chegarEmColetando();
	falsos.erroInibidorComando = FALHA_DE_ESCRITA;
	zassert_true(processarAte(ESTADO_ERRO, TEMPO_SOPRO_MINIMO_MS + 100U));
	falsos_encerrarSopro();
	conferirErro(FALHA_INIBIDOR);
}

ZTEST(falhas, test_falha_de_leitura_na_coleta_leva_ao_erro)
{
	zassert_ok(bafometro_iniciar());
	chegarEmColetando();
	processarPor(1000U);
	falsos.erroLeitura = FALHA_DE_ESCRITA;
	zassert_true(processarAte(ESTADO_ERRO, 2U * PERIODO_AMOSTRAGEM_MS));
	falsos_encerrarSopro();
	conferirErro(FALHA_SENSOR_ALCOOL);
}

ZTEST(falhas, test_falha_de_leitura_na_calibracao_leva_ao_erro)
{
	zassert_ok(bafometro_iniciar());
	chegarEmAguardandoSopro();
	falsos.erroLeitura = FALHA_DE_ESCRITA;
	zassert_ok(bafometro_publicarComando(COMANDO_CALIBRAR));
	zassert_true(processarAte(ESTADO_ERRO, 2U * INTERVALO_CALIBRACAO_MS));
	conferirErro(FALHA_SENSOR_ALCOOL);
}

/* RF10 a partir do estado liberado: a falha volta a ativar o inibidor. */
ZTEST(falhas, test_falha_depois_da_liberacao_ativa_o_inibidor)
{
	zassert_ok(bafometro_iniciar());
	chegarEmColetando();
	zassert_true(processarAte(ESTADO_APRESENTANDO_RESULTADO, TEMPO_SOPRO_MINIMO_MS + 100U));
	falsos_encerrarSopro();
	zassert_false(falsos.inibidorAtivo);
	zassert_equal(falsos.fase, FASE_OPERACAO);

	zassert_ok(bafometro_publicarFalha(FALHA_SENSOR_ALCOOL));
	zassert_true(processarAte(ESTADO_ERRO, 10U));
	conferirErro(FALHA_SENSOR_ALCOOL);
}
```
